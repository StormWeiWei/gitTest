/****************************************Copyright (c)**************************************************
**                               Guangzou ZLG-MCU Development Co.,LTD.
**                                      graduate school
**                                 http://www.zlgmcu.com
**
**--------------File Info-------------------------------------------------------------------------------
** File name:			main.c
** Last modified Date:  2004-09-16
** Last Version:		1.0
** Descriptions:		The main() function example template
**
**------------------------------------------------------------------------------------------------------
** Created by:			Chenmingji
** Created date:		2004-09-16
** Version:				1.0
** Descriptions:		The original version
**
**------------------------------------------------------------------------------------------------------
** Modified by:
** Modified date:
** Version:
** Descriptions:
**
********************************************************************************************************/
#include "config.h"

#define   BEEPCON      1<<7             //P0.7脚控制交流蜂鸣器

/*******************************************************************************************************
**名称：IRQ_Eint1
**功能：外部中断1处理函数                        
********************************************************************************************************/
void __irq IRQ_Eint1(void)
{
    uint32 i;
    
    while((EXTINT & 0X02)!= 0)	        //等待外部中断信号恢复为高电平（若信号保持为低电平，中断标志会一直保持置位）
    {
    
        IO0CLR = BEEPCON;
        for(i = 0; i < 100; i++);
        IO0SET = BEEPCON;
        for(i = 0; i < 100; i++);
        
        EXTINT = 0x02;                  //清除EINT1中断标志
        
    }
    								   
    EXTINT = 0x02;                     //清除EINT1中断标志
    VICVectAddr = 0;   				   //退出中断服务函数前必须清零VICVectAddr，以便下次能再次响应外部中断
}
/*******************************************************************************************************
**名称：main
**功能：初始化外部中断1（EINT1）为向量中断，并设置为电平触发、低电平触发
**调试说明：在Startup.s文件中使能IRQ中断                          
********************************************************************************************************/
int main (void)
{
    PINSEL0 = 0X20000000;               //设置引脚连接，P0.14设置为EINT1
    IO0DIR = BEEPCON;				    //设置蜂鸣器控制脚为输出，其他为输入
    IO0SET = BEEPCON;					//关闭蜂鸣器
    
    /*设置EINT1中断的触发模式*/
    EXTMODE = 0x00;						//设置EINT1中断为电平触发模式
    EXTPOLAR = 0;						//设置EINT1中断为低电平触发
    
   /*打开EINT1中断（设置向量控制器，使用向量IRQ）*/ 
    VICIntSelect = 0x0;					//设置所有中断为IRQ中断
    VICVectCntl0 = 0x20|15;				//分配EINT1中断到向量0
    VICVectAddr0 =(uint32)IRQ_Eint1;    //设置中断服务程序地址
    EXTINT = 0x02;						//清除EINT1中断标志
    VICIntEnable = 1<<15;				//使能EINT1中断
    
    while(1);                           //等待中断
     
    return 0;
    
}
/*********************************************************************************************************
**                            End Of File
********************************************************************************************************/
