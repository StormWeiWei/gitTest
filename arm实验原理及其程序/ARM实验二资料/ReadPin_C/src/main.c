/****************************************Copyright (c)**************************************************
**                               Guangzou ZLG-MCU Development Co.,LTD.
**                                      graduate school
**                                 http://www.zlgmcu.com
**
**--------------File Info-------------------------------------------------------------------------------
** File name:			main.c
** Last modified Date:  2004-09-16
** Last Version:		1.0
** Descriptions:		The main() function example template
**
**------------------------------------------------------------------------------------------------------
** Created by:			Chenmingji
** Created date:		2004-09-16
** Version:				1.0
** Descriptions:		The original version
**
**------------------------------------------------------------------------------------------------------
** Modified by:
** Modified date:
** Version:
** Descriptions:
**
********************************************************************************************************/
#include "config.h"

#define    BEEP   1<<7		   //P0.7脚控制蜂鸣器
#define    KEY1   1<<18        //P0.18叫接Key1

/*******************************************************************************************************
**名称：DelayNS
**功能：延时函数                        
********************************************************************************************************/
void Delay(uint32 dly)
{
    uint32 i;
    for(; dly > 0; dly--)
        for(i =0; i < 100; i++);   
}

/*******************************************************************************************************
**名称：main
**功能：通过KEY1按键控制蜂鸣器叫
**调试说明：将SmartSOPC教学实验开发平台上的A6区的JP7短接，B2区的JP6的KEY1和BEEP短接。                           
********************************************************************************************************/
int main (void)
{
    PINSEL0 = 0;
    IO0DIR = BEEP;              //BEEP脚设置为输出，KEY1设置为输入。
    IO0SET = BEEP;              //BEEP ＝ 1， 关闭蜂鸣器
    while(1)
    {
        if((IO0PIN & (KEY1)) == 0)
        {
            IO0CLR = BEEP;	   
            Delay(1);
            IO0SET = BEEP;
            Delay(1);
        }
    }
}
/*********************************************************************************************************
**                            End Of File
********************************************************************************************************/
