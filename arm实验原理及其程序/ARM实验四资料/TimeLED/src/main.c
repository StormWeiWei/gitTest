/****************************************Copyright (c)**************************************************
**                               Guangzou ZLG-MCU Development Co.,LTD.
**                                      graduate school
**                                 http://www.zlgmcu.com
**
**--------------File Info-------------------------------------------------------------------------------
** File name:			main.c
** Last modified Date:  2004-09-16
** Last Version:		1.0
** Descriptions:		The main() function example template
**
**------------------------------------------------------------------------------------------------------
** Created by:			Chenmingji
** Created date:		2004-09-16
** Version:				1.0
** Descriptions:		The original version
**
**------------------------------------------------------------------------------------------------------
** Modified by:
** Modified date:
** Version:
** Descriptions:
**
********************************************************************************************************/
#include "config.h"

#define     LED1     1<<22   	  //P1.22脚控制核心板上的LED1

/*******************************************************************************************************
**名称：Time0Init
**功能：初始化定时器0，定时时间为1s                           
********************************************************************************************************/
void Time0Init(void)
{
    /* Fcclk = Fosc * 4 = 11.0592MHz * 4 = 44.2368MHz
       Fpclk = Fcclk / 4 = 44.2368MHz / 4 = 11.0592MHz 
    */
    T0PR = 99;								//设置定时器0分频为100分频，得110592Hz
    T0MCR = 0x03;                           //匹配通道0匹配中断并复位T0TC
    T0MR0 = 110592;							//比较值（1s定时值）
    T0TCR = 0X03;							//启动并复位T0TC
    T0TCR = 0x01;
    
}

/*******************************************************************************************************
**名称：main
**功能：定时器定时1s，控制核心板上的LED1闪烁
**调试说明：将核心板插到SmartSOPC上，运行程序即可。                           
********************************************************************************************************/
int main (void)
{
    PINSEL2 &=(~(1<<3));	   //使能P1.16～P1.25为GPIO
    IO1DIR = LED1;			   //LED1设置为输出
    IO1SET = LED1;			   //熄灭LED1
    Time0Init();			   //定时器0初始化
    
    while(1)
    {
        while((T0IR&0x01)==0);	    //等待定时时间到
        T0IR = 0x01;				//清除定时器0匹配中断标志
        
        /*翻转LED1控制脚，令核心板上的LED1闪烁*/
        if((IO1SET & LED1)==0)		
        {
            IO1SET = LED1;
        }
        else
        {
            IO1CLR = LED1;
        }
    }
     
    return 0;
}
/*********************************************************************************************************
**                            End Of File
********************************************************************************************************/
