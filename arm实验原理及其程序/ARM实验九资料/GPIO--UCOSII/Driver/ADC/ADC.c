/****************************************Copyright (c)**************************************************
**                               广州周立功单片机发展有限公司
**                                     研    究    所
**                                        产品一部 
**
**                                 http://www.zlgmcu.com
**
**--------------文件信息--------------------------------------------------------------------------------
**文   件   名: ADC.c
**创   建   人: 张斌
**最后修改日期: 2006-5-13
**描        述: LPC2200 ADC应用软件包。
**
**--------------历史版本信息----------------------------------------------------------------------------
** 创建人: 张斌
** 版  本: V1.0
** 日　期: 2006-5-13
** 描　述: LPC2200 ADC应用软件包。
**
**------------------------------------------------------------------------------------------------------
** 修改人:
** 版  本:
** 日　期:
** 描　述:
**
**--------------当前版本修订------------------------------------------------------------------------------
** 修改人: 
** 日　期:
** 描　述:该软件包基于16位总线。
**
**------------------------------------------------------------------------------------------------------
********************************************************************************************************/
#include "config.h"

#define		AD_0	(1<<22)	//P0.27第二功能
#define		AD_1	(1<<24)	//P0.28第二功能
#define		AD_2	(1<<26)	//P0.29第二功能
#define		AD_3	(1<<28)	//P0.30第二功能
/*********************************************************************************************************
** 函数名称：uint8	ADC_Init(uint8 ADn,uint32	Fadc)
** 功能描述：AD初始化操作。
** 入口参数：ADn	AD通道，0~7
**			 Fadc	ADC的转换时钟,最大的转换速率为4.5M,即，4500000
** 出口参数：0 	初始化失败
**           1	初始化成功
** 说明：转换时钟最大4.5MHz。
**		 使用软件方式启动。
********************************************************************************************************/
uint8	ADC_Init(uint8 ADn,uint32  Fadc)
{
	if(ADn > 7)		return(0);				//参数有误，直接返回
	if(Fadc > 4500000)	Fadc = 4500000;		//最大的转换速率为4.5M
	switch(ADn)								//首先进行引脚初始化
	{
		case	0:		
			PINSEL1 = (PINSEL1&(~(3<<22)))|AD_0;	//AIN0--P0.27
			break;
		case	1:		
			PINSEL1 = (PINSEL1&(~(3<<24)))|AD_1;	//AIN1--P0.28
			break;
		case	2:		
			PINSEL1 = (PINSEL1&(~(3<<26)))|AD_2;	//AIN2--P0.29
			break;
		case	3:		
			PINSEL1 = (PINSEL1&(~(3<<28)))|AD_3;	//AIN3--P0.30
			break;
		case	4:
			PINSEL2 |= (1 << 21);					//AIN4--P2.30
			break;
		case	5:	
			PINSEL2 |= (1 << 22);					//AIN5--P2.31
			break;
		case	6:			
			PINSEL2 |= (1 << 6);					//AIN6--P3.29
			break;				
		case	7:		
			PINSEL2 |= (1 << 7);					//AIN7--P3.28
			break;
	}
	ADCR = (1<<ADn)|				//选择通道ADn
			((Fpclk/Fadc - 1)<<8)|	//转换时钟最大为4.5MHz
			(0<<16)|				//BURST=0，软件控制转换操作
			(0<<17)|				//CLKS=0,使用11 clock转换
			(1<<21)|				//PDN=1.正常工作方式
			(0<<22)|				//TEST1:0=00,正常工作模式
			(1<<24)|				//START=1,直接启动ADC转换
			(0<<27);				//直接启动ADC转换时，此位无效
	return(1);
}
/*********************************************************************************************************
** 函数名称：uint32	Read_ADC(uint8 ADn)
** 功能描述：读取AD转换值。
** 入口参数：ADn	AD通道，0~7
** 出口参数：读取出来的AD结果
** 说明：软件采用查询方式等待转换结束,同时已经将结果经过了处理，转换结果为：0～3ff。
**		 如果参数有误，转换结果为0。
********************************************************************************************************/
uint32	Read_ADC(uint8 ADn)
{
	volatile uint32	ADC_Data;
	if(ADn > 7)		return(0);			//参数有误，直接返回
	ADC_Data = ADDR;
	ADCR = ADCR & (0xffffff00) | (1<<ADn) | (1<<24);		//选择通道ADn并启动转换
	while((ADDR & 0x80000000)==0);		//等待转换结束
	ADCR = ADCR | (1 << 24);			// 再次启运转换
	while( (ADDR&0x80000000)==0 );

	ADC_Data = ADDR;
	ADC_Data = (ADC_Data>>6) & 0x3ff;	//处理转换值
	return(ADC_Data);
}