/****************************************Copyright (c)**************************************************
**                               Guangzou ZLG-MCU Development Co.,LTD.
**                                      graduate school
**                                 http://www.zlgmcu.com
**
**--------------File Info-------------------------------------------------------------------------------
** File name:			main.c
** Last modified Date:  2004-09-16
** Last Version:		1.0
** Descriptions:		The main() function example template
**
**------------------------------------------------------------------------------------------------------
** Created by:			Chenmingji
** Created date:		2004-09-16
** Version:				1.0
** Descriptions:		The original version
**
**------------------------------------------------------------------------------------------------------
** Modified by:
** Modified date:
** Version:
** Descriptions:
**
********************************************************************************************************/
#include "config.h"
#define  DC_MOTOR_A  		1<<21 //直流电机转动控制脚A (P0.21)
#define  DC_MOTOR_B			1<<22 //直流电机转动控制脚B	(P0.22)


#define  PWM_CYCLE          (Fpclk/100)    //PWM周期为10ms
#define  PWM_STEP           PWM_CYCLE/10   
/*********************************************************************************************************
*名    称：void PWM_Init(void)
*功    能：直流电机PWM控制初始化
*入口参数：无          
*出口参数：无 
*说    明：IO初始化，PWM初始化。
********************************************************************************************************/
void PWM_Init(void)
{
    // P0.21 --- PWM5
    // P0.22 --- GPIO 
    PINSEL1 &= (~(3<<10|3<<12));
    PINSEL1 |= (1<<10|0<<12);
    
    IO0DIR =  DC_MOTOR_B;
    IO0CLR =  DC_MOTOR_B;
    
    //PWM初始化
    PWMTCR = 0x02;		    //禁止定时器。
    PWMPR = 0;			    //无分频

    PWMPCR &= ~0x2020;
    PWMPCR |= 0x2000;       //PWM5单边沿模式。使能PWM5输出
    
    //PWM匹配控制
    PWMMCR &= (~(3<<0|7<<12|7<<15));
    PWMMCR |= 0x02;
    
    PWMMR0 = PWM_CYCLE;		//PWM周期
    PWMMR5 = 0;	  			//初始化后电机停止运行
    
    PWMLER |= 0x21;	        //使能更新PWM0
    PWMTCR = 0x09;    	    //启动PWM
 
}


/*********************************************************************************************************
*名    称：void Change_PWM(uint32 spd)
*功    能：改变PWM脉冲的占空比从而改变直流电机转速。
*入口参数：uint32 spd     PWM5匹配值            
*出口参数：无 
*说    明：通过改变PWM5的占空比来改变直流电机的转速。
********************************************************************************************************/
void Change_PWM(uint32 spd)
{  
     if(spd > PWM_CYCLE) 
     {
        spd = PWM_CYCLE;
     }
     
     PWMMR5 = spd;
     PWMLER |= 0x20;	                //使能更新PWM5        
}

/*********************************************************************************************************
*名    称：void Delay(void)
*功    能：延时函数。
********************************************************************************************************/

void Delay(void)
{
    uint32 i;
    for(i = 0; i < 100000; i++);
}
/******************************************************************************************
* 名称：main()
* 功能：初始化PWM，驱动直流电机运转。
* 说明：将SmartSPOC板上的A2区的JP6的Motor_A 和Motor_B短接。
*******************************************************************************************/
int main (void)
{
    uint32 speed = PWM_CYCLE;    //速度初始化为最大
    
    PWM_Init(); 
    Change_PWM(speed);           //设定速度
    
    while(1)
    {
        Delay();
        
        if(speed < PWM_STEP)
        {
           speed = PWM_CYCLE;
        }
        else
        {
            speed -= PWM_STEP;   //减速
        }
        
        Change_PWM(speed);       //改变速度
    } 
    
    return 0;
}

/*********************************************************************************************************
**                            End Of File
********************************************************************************************************/
